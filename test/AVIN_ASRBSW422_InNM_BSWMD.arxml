AUTOSAR XML (schema 00044)
# Copyright (C) AVIN SYSTEMS PVT LTD 2020 - All Rights Reserved Unauthorized copying of this file, via any medium is strictly prohibited.
package /ArPackage_InNM
  bsw implementation BswImplementation_InNM: sw-version=2.2.2, used-code-generator=2.1.1, vendor-id=72, ar-release-version=4.2.2, behavior=BswInternalBehavior_InNM
  bsw module description InNM: module-id=1000
    bsw internal behavior BswInternalBehavior_InNM
      4 x exclusive area:
        InNM_NetworkStatus
        InNM_WaitBusSleep
        InNM_FastRecoveryCnt
        InNM_SlowRecoveryCnt
      exclusive-area-policys:
        api-principle=COMMON, exclusive-area=InNM_NetworkStatus
        api-principle=COMMON, exclusive-area=InNM_WaitBusSleep
        api-principle=COMMON, exclusive-area=InNM_FastRecoveryCnt
        api-principle=COMMON, exclusive-area=InNM_SlowRecoveryCnt
      12 x bsw called entity, all with scheduler-name-prefix=InNM:
        StartNM: can-enter-exclusive-area=NetworkStatus, implemented-entry=InNM_StartNM
        StopNM: can-enter-exclusive-area=NetworkStatus, implemented-entry=InNM_StopNM
        GetStatus: can-enter-exclusive-area=NetworkStatus, implemented-entry=InNM_GetStatus
        GotoMode: can-enter-exclusive-area=NetworkStatus, implemented-entry=InNM_GotoMode
        D_Status: can-enter-exclusive-area=NetworkStatus, implemented-entry=InNM_D_Status
        InNM_BusOffFastRecoveryTime: implemented-entry=InNM_InNM_BusOffFastRecoveryTime
        InNM_BusOffSlowRecoveryTime: implemented-entry=InNM_InNM_BusOffFastRecoveryTime
        InNM_BusOffFastRecoveryCount: implemented-entry=InNM_InNM_BusOffFastRecoveryCount
        InNM_NodeAbsentThreshold: implemented-entry=InNM_InNM_NodeAbsentThreshold
        InNM_NodeRecoveryThreshold: implemented-entry=InNM_InNM_NodeRecoveryThreshold
        I_MessageTransfer: can-enter-exclusive-area=NetworkStatus, implemented-entry=InNM_I_MessageTransfer
        I_MessageTimeOut: implemented-entry=InNM_I_MessageTimeOut
      bsw schedulable entity InNM_MainFunction: can-enter-exclusive-area=[WaitBusSleep, FastRecoveryCnt, SlowRecoveryCnt], minimum-start-interval=0.001, reentrancy-level=SINGLE-CORE-REENTRANT, implemented-entry=InNM_MainFunction, scheduler-name-prefix=InNM
      bsw timing event InNMMainFunctionTimePeriod: starts-on-event=InNM_MainFunction, period=0.005
      bsw scheduler name prefix InNM
  13 x bsw module entry, all with is-synchronous=true, sw-service-impl-policy=STANDARD:
    StartNM: is-reentrant=false, call-type=REGULAR, execution-context=UNSPECIFIED
    StopNM: is-reentrant=false, call-type=REGULAR, execution-context=UNSPECIFIED
    GetStatus: is-reentrant=true, call-type=REGULAR, execution-context=UNSPECIFIED
    GotoMode: is-reentrant=true, call-type=REGULAR, execution-context=UNSPECIFIED
    InNM_BusOffFastRecoveryTime: is-reentrant=true, call-type=REGULAR, execution-context=UNSPECIFIED
    InNM_BusOffSlowRecoveryTime: is-reentrant=true, call-type=REGULAR, execution-context=UNSPECIFIED
    InNM_BusOffFastRecoveryCount: is-reentrant=true, call-type=REGULAR, execution-context=UNSPECIFIED
    InNM_NodeAbsentThreshold: is-reentrant=true, call-type=REGULAR, execution-context=UNSPECIFIED
    InNM_NodeRecoveryThreshold: is-reentrant=true, call-type=REGULAR, execution-context=UNSPECIFIED
    I_MessageTransfer: is-reentrant=true, call-type=REGULAR, execution-context=UNSPECIFIED
    I_MessageTimeOut: is-reentrant=true, call-type=REGULAR, execution-context=UNSPECIFIED
    D_Status: is-reentrant=true, call-type=CALLBACK, execution-context=UNSPECIFIED
    InNM_MainFunction: is-reentrant=false, call-type=SCHEDULED, execution-context=TASK
