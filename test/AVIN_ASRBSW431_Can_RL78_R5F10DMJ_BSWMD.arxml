AUTOSAR XML (schema 00044)
# Copyright (C) AVIN SYSTEMS PVT LTD 2020 - All Rights Reserved Unauthorized copying of this file, via any medium is strictly prohibited.
package /ArPackage_Can
  bsw implementation BswImplementation_Can: sw-version=2.2.0, used-code-generator=2.2.1, vendor-id=72, ar-release-version=4.3.1, behavior=BswInternalBehavior_Can
  bsw module description Can: module-id=80
    bsw internal behavior BswInternalBehavior_Can: bsw-exclusive-area-policy{api-principle=COMMON, exclusive-area=Can_RxIndicationProtect}
      exclusive area Can_RxIndicationProtect
      5 x bsw interrupt entity, all with scheduler-name-prefix=Can:
        Can_CheckWakeup: implemented-entry=Can_CheckWakeup
        Can_DisableControllerInterrupts: implemented-entry=Can_DisableControllerInterrupts
        Can_EnableControllerInterrupts: implemented-entry=Can_EnableControllerInterrupts
        Can_GetErrorCounter: implemented-entry=Can_GetErrorCounter
        Can_GetVersionInfo: implemented-entry=Can_GetVersionInfo
      bsw called entity Can_Init: implemented-entry=Can_Init, scheduler-name-prefix=Can
      bsw schedulable entity Can_MainFunction_Read: can-enter-exclusive-area=Can_RxIndicationProtect, implemented-entry=Can_MainFunction_Read, scheduler-name-prefix=Can
      bsw schedulable entity Can_MainFunction_Wakeup: implemented-entry=Can_MainFunction_Wakeup, scheduler-name-prefix=Can
      bsw schedulable entity Can_MainFunction_Write: implemented-entry=Can_MainFunction_Write, scheduler-name-prefix=Can
      bsw interrupt entity Can_SetControllerMode: implemented-entry=Can_SetControllerMode, scheduler-name-prefix=Can
      bsw interrupt entity Can_Write: implemented-entry=Can_Write, scheduler-name-prefix=Can
      bsw scheduler name prefix Can
  11 x bsw module entry, all with sw-service-impl-policy=STANDARD:
    Can_CheckWakeup: is-reentrant=false, is-synchronous=true, call-type=REGULAR, execution-context=UNSPECIFIED
    Can_DisableControllerInterrupts: is-reentrant=true, is-synchronous=true, call-type=REGULAR, execution-context=UNSPECIFIED
    Can_EnableControllerInterrupts: is-reentrant=true, is-synchronous=true, call-type=REGULAR, execution-context=UNSPECIFIED
    Can_GetErrorCounter: is-reentrant=true, is-synchronous=true, call-type=REGULAR, execution-context=UNSPECIFIED
    Can_GetVersionInfo: is-reentrant=true, is-synchronous=true, call-type=REGULAR, execution-context=UNSPECIFIED
    Can_Init: is-reentrant=false, is-synchronous=true, call-type=REGULAR, execution-context=UNSPECIFIED
    Can_MainFunction_Read: is-reentrant=true, is-synchronous=false, call-type=SCHEDULED, execution-context=TASK
    Can_MainFunction_Wakeup: is-reentrant=true, is-synchronous=false, call-type=SCHEDULED, execution-context=TASK
    Can_MainFunction_Write: is-reentrant=true, is-synchronous=false, call-type=SCHEDULED, execution-context=TASK
    Can_SetControllerMode: is-reentrant=false, is-synchronous=false, call-type=REGULAR, execution-context=UNSPECIFIED
    Can_Write: is-reentrant=true, is-synchronous=true, call-type=REGULAR, execution-context=UNSPECIFIED
